## meta-agl-AGLsdk/conf/layer.conf
```bitbake
# We have a conf and classes directory, add to BBPATH
BBPATH =. "${LAYERDIR}:"

# We have recipes-* directories, add to BBFILES
BBFILES += "${LAYERDIR}/recipes-*/*/*.bb \
            ${LAYERDIR}/recipes-*/*/*.bbappend"

BBFILE_COLLECTIONS += "aglsdk"
BBFILE_PATTERN_aglsdk = "^${LAYERDIR}/"
BBFILE_PRIORITY_aglsdk = "7"
```

## meta-agl-sdkbootstrap/conf/layer.conf
```bitbake
# We have a conf and classes directory, add to BBPATH
BBPATH =. "${LAYERDIR}:"

# We have recipes-* directories, add to BBFILES
BBFILES += "${LAYERDIR}/recipes-*/*/*.bb \
            ${LAYERDIR}/recipes-*/*/*.bbappend"

BBFILE_COLLECTIONS += "sdkbootstrap"
BBFILE_PATTERN_sdkbootstrap = "^${LAYERDIR}/"
BBFILE_PRIORITY_sdkbootstrap = "7"
```

## meta-qt5-yomo/conf/layer.conf
```bitbake
# We have a conf and classes directory, append to BBPATH
BBPATH .= ":${LAYERDIR}"

# We have a recipes directory, add to BBFILES
BBFILES += " \
    ${LAYERDIR}/recipes-*/*/*.bb \
    ${LAYERDIR}/recipes-*/*/*.bbappend \
"

BBFILE_COLLECTIONS += "qt5-yomo"
BBFILE_PATTERN_qt5-yomo := "^${LAYERDIR}/"
BBFILE_PRIORITY_qt5-yomo = "7"
```
